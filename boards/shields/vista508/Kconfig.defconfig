## boards/shields/vista508/Kconfig.defconfig
```kconfig
# Copyright (c) 2023 The ZMK Contributors
# SPDX-License-Identifier: MIT

if SHIELD_VISTA508

config LV_Z_VDB_SIZE
    default 100

config LV_DPI_DEF
    default 161

config LV_Z_BITS_PER_PIXEL
    default 1

choice LV_COLOR_DEPTH
    default LV_COLOR_DEPTH_1
endchoice

choice ZMK_DISPLAY_WORK_QUEUE
    default ZMK_DISPLAY_WORK_QUEUE_DEDICATED
endchoice

choice ZMK_DISPLAY_STATUS_SCREEN
    default ZMK_DISPLAY_STATUS_SCREEN_CUSTOM
endchoice

config LV_Z_MEM_POOL_SIZE
    default 8192 if ZMK_DISPLAY_STATUS_SCREEN_CUSTOM
    default 5120 if ZMK_DISPLAY_STATUS_SCREEN_BUILT_IN

config ZMK_DISPLAY_STATUS_SCREEN_CUSTOM
    imply VISTA508_WIDGET_STATUS

config VISTA508_WIDGET_STATUS
    bool "Custom Vista508 status widget"
    select LV_FONT_MONTSERRAT_16
    select LV_USE_IMAGE
    select LV_USE_CANVAS

config VISTA508_WIDGET_INVERTED
    bool "Invert custom status widget colors"

if !ZMK_SPLIT || ZMK_SPLIT_ROLE_CENTRAL

config VISTA508_WIDGET_STATUS
    select LV_FONT_MONTSERRAT_28
    select LV_FONT_MONTSERRAT_18
    select LV_FONT_MONTSERRAT_16
    select LV_FONT_MONTSERRAT_12

choice VISTA508_WIDGET_TOP
    prompt "Central widget top-canvas content"
    depends on VISTA508_WIDGET_STATUS
    default VISTA508_WIDGET_TOP_WPM

config VISTA508_WIDGET_TOP_WPM
    bool "WPM statistics (original)"
    select ZMK_WPM

config VISTA508_WIDGET_TOP_MODS_ART
    bool "Held-modifier indicators + a procedural landscape"

endchoice

endif # !ZMK_SPLIT || ZMK_SPLIT_ROLE_CENTRAL

config ZMK_DISPLAY_STATUS_SCREEN_BUILT_IN
    select LV_FONT_MONTSERRAT_26

endif # SHIELD_VISTA508
```
