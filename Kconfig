## Kconfig
```kconfig
DT_COMPAT_ZMK_BEHAVIOR_MOMENTARY_LAYER_LOCK := zmk,behavior-momentary-layer-lock

config ZMK_BEHAVIOR_MOMENTARY_LAYER_LOCK
    bool
    default $(dt_compat_enabled,$(DT_COMPAT_ZMK_BEHAVIOR_MOMENTARY_LAYER_LOCK))

DT_COMPAT_ZMK_BATTERY_NRF_VDDH_CURVE := zmk,battery-nrf-vddh-curve

config ZMK_BATTERY_NRF_VDDH_CURVE
    bool
    default $(dt_compat_enabled,$(DT_COMPAT_ZMK_BATTERY_NRF_VDDH_CURVE))
    select ADC
    select ZMK_BATTERY
    depends on SENSOR
```

## config/west.yml
```yaml
manifest:
  remotes:
    - name: zmkfirmware
      url-base: https://github.com/zmkfirmware
    - name: dhruvinsh
      url-base: https://github.com/dhruvinsh
    - name: MickiusMousius
      url-base: https://github.com/MickiusMousius
  projects:
    - name: zmk
      remote: zmkfirmware
      revision: 484a0547078228f6957ed164523823e39fbedec4
      import: app/west.yml
    - name: zmk-tri-state
      remote: dhruvinsh
      revision: main
      clone-depth: 1
    - name: zmk-ls0xxvcom-driver
      remote: MickiusMousius
      # A commit, not main: a rebuild must not pull in a new display driver.
      revision: a6b3a6df55129143bdaca9592e903933a41d0dfb
      clone-depth: 1
  self:
    path: config
```

## dts/bindings/sensor/zmk,battery-nrf-vddh-curve.yaml
```yaml
# Copyright (c) 2021 The ZMK Contributors
# SPDX-License-Identifier: MIT

description: |
  Battery SoC monitoring using nRF VDDH, converting voltage to percent
  through a LiPo discharge-curve lookup. Vendored replacement for
  zmk,battery-nrf-vddh; see src/sensors/battery_nrf_vddh_curve.c.

compatible: "zmk,battery-nrf-vddh-curve"
```
